## board/variscite/mx6ul_var_dart/Kconfig
```kconfig
if TARGET_MX6UL_VAR_DART

config SYS_BOARD
	default "mx6ul_var_dart"

config SYS_VENDOR
	default "variscite"

config SYS_CONFIG_NAME
	default "mx6ul_var_dart"

config ENV_SIZE
	default 0x4000

config ENV_OFFSET
	default 0x20000

config IMX_WATCHDOG
	bool "IMX watchdog"
	default y

choice
	prompt "Serial Console UART"
	default DART_CONSOLE_UART1

config DART_SERIAL_CONSOLE_UART1
	bool "UART1"
config DART_SERIAL_CONSOLE_UART7
	bool "UART7"

endchoice

endif
```
